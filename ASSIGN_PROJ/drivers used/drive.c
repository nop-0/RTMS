/*
SKYFALL library

prepared by Nopphadon Uttraphan (24988)

RTMS Project 25th MARCH 2021
*/
int x,y;

int Yspeed = 4, Xspeed = 8; // controls the speed of aliens and pod

int Alien1_x=16,  Alien1_y=8;
int Alien2_x=32,  Alien2_y=48;
int Alien3_x=64,  Alien3_y=25;
int Alien4_x=96,  Alien4_y=55;	
int Alien5_x=112,  Alien5_y=32;
int Pod_x=64, Pod_y=56;


unsigned char Alien1[] = {
	0x00,0x10,0x38,0x7C,0x36,0x1E,0x17,0x3F,0x3F,0x17,0x1E,0x36,0x7C,0x38,0x10,0x00};
unsigned char Alien2[] = {
	0x00,0x70,0x18,0x7D,0x36,0x34,0x3C,0x3C,0x3C,0x3C,0x34,0x36,0x7D,0x18,0x70,0x00};
unsigned char Alien3[] = {
	0x00,0x5C,0x30,0x1E,0x3F,0x1A,0x1A,0x1E,0x1E,0x1A,0x1A,0x3F,0x1E,0x30,0x5C,0x00};
unsigned char Alien4[] = {
	0x00,0x48,0x4C,0x2E,0x3E,0x1A,0x1B,0x2F,0x2F,0x1B,0x1A,0x3E,0x2E,0x4C,0x48,0x00};
unsigned char Alien5[] = {
	0x00,0x00,0x00,0x08,0x4C,0x2E,0x5B,0x2F,0x2F,0x5B,0x2E,0x4C,0x08,0x00,0x00,0x00};
unsigned char Pod[] = {
	0x00,0x40,0xE0,0xE0,0xE0,0xE0,0xF8,0xFE,0xFE,0xF8,0xE0,0xE0,0xE0,0xE0,0x40,0x00};

//gameover screen	
unsigned char gameover[] = 
{
 	0xFF,0xFF,0xFF,0xFF,0xFF,0xFF,0x1F,0x1F,0x07,0x07,0x07,0x07,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0xFF,
	0xFF,0xFF,0xFF,0xFF,0xFF,0xFF,0x00,0x00,0x00,0x00,0x00,0x00,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0xFF,
	0xFF,0xFF,0xFF,0xFF,0xFF,0xFF,0x00,0x00,0x00,0x00,0x00,0x00,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0xFF,
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	0x3F,0x3F,0x3F,0x3F,0x3F,0x3F,0x3F,0x3F,0x3F,0x3F,0x3F,0x3F,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0x3F
};
/////////////////////////////////////////////////////////////////////////////////////
void generate_alien(void) //generates and animates the aliens
{
	
	draw_Bmp16x8(Alien1_x, Alien1_y,FG_COLOR,BG_COLOR, Alien1);
	draw_Bmp16x8(Alien2_x, Alien2_y,FG_COLOR,BG_COLOR, Alien2);
	draw_Bmp16x8(Alien3_x, Alien3_y,FG_COLOR,BG_COLOR, Alien3);	
	draw_Bmp16x8(Alien4_x, Alien4_y,FG_COLOR,BG_COLOR, Alien4);
	draw_Bmp16x8(Alien5_x, Alien5_y,FG_COLOR,BG_COLOR, Alien5);
	
	osDelay(200);
	
	draw_Bmp16x8(Alien1_x, Alien1_y,BG_COLOR,BG_COLOR, Alien1);		
	draw_Bmp16x8(Alien2_x, Alien2_y,BG_COLOR,BG_COLOR, Alien2);
	draw_Bmp16x8(Alien3_x, Alien3_y,BG_COLOR,BG_COLOR, Alien3);
	draw_Bmp16x8(Alien4_x, Alien4_y,BG_COLOR,BG_COLOR, Alien4);
	draw_Bmp16x8(Alien5_x, Alien5_y,BG_COLOR,BG_COLOR, Alien5);		
}
///////////////////////////////////////////////////////////////////////////////////
void generate_pod(void) //generates and animates the pod
{
	draw_Bmp16x8(Pod_x,Pod_y, FG_COLOR,BG_COLOR, Pod);
	osDelay(200);
	draw_Bmp16x8(Pod_x,Pod_y, BG_COLOR,BG_COLOR, Pod); 
}
///////////////////////////////////////////////////////////////////////////////////
int livesUpdate(int lives) //tracks damage taken by pod
{
	int i;
	if((Pod_x == Alien1_x && Pod_y == Alien1_y)||
			(Pod_x == Alien2_x && Pod_y == Alien2_y)||
			(Pod_x == Alien3_x && Pod_y == Alien3_y)||
			(Pod_x == Alien4_x && Pod_y == Alien4_y)||
			(Pod_x == Alien5_x && Pod_y == Alien5_y)
	){
		lives--;
		osDelay(100);
		
//		for (i = 0; i <= lives; i++) // updates LEDs according to Damage taken (not working as intended)
//		{
//			GPIO_SET_OUT_DATA(PC, 11+i);
//		}
	}
	return lives;
}	
///////////////////////////////////////////////////////////////////////////////////
int scoresUpdate(int score) //tracks score of the pod
{
	if((Pod_x != Alien1_x && Pod_y != Alien1_y)||
			(Pod_x != Alien2_x && Pod_y != Alien2_y)||
			(Pod_x != Alien3_x && Pod_y != Alien3_y)||
			(Pod_x != Alien4_x && Pod_y != Alien4_y)||
			(Pod_x != Alien5_x && Pod_y != Alien5_y)
	){
		score++;
		osDelay(100);
	}
	return score;
}	
///////////////////////////////////////////////////////////////////////////////
void CollisionCheck(void) // check boundaries of aliens and pod
{
	Alien1_y = Alien1_y + Yspeed;	
	Alien2_y = Alien2_y + Yspeed;
	Alien3_y = Alien3_y + Yspeed;		
	Alien4_y = Alien4_y + Yspeed;
	Alien5_y = Alien5_y + Yspeed;
	
	if (Alien1_y>(LCD_Ymax+16)){ //boundary loop for aliens (Y coordinates)
		Alien1_y=0;
		Alien1_x = Alien1_x + 16;
	}
	if (Alien2_y>(LCD_Ymax+16)){
		Alien2_y=0;
		Alien2_x = Alien2_x + 16;
	} 
	if (Alien3_y>(LCD_Ymax+16)){
		Alien3_y=0;
		Alien3_x = Alien3_x + 16;
	}
	if (Alien4_y>(LCD_Ymax+16)){
		Alien4_y=0;
		Alien4_x = Alien4_x + 16;
	}
	if (Alien5_y>(LCD_Ymax+16)){
		Alien5_y=0;
		Alien5_x = Alien5_x + 16;
	}
	
	if (Alien1_x>(LCD_Xmax-16)) Alien1_x=0; //resets aliens position past Xmax
	if (Alien2_x>(LCD_Xmax-16)) Alien2_x=0;
	if (Alien3_x>(LCD_Xmax-16)) Alien3_x=0;
	if (Alien4_x>(LCD_Xmax-16)) Alien4_x=0;
	if (Alien5_x>(LCD_Xmax-16)) Alien5_x=0;
	
	if (Pod_x>(LCD_Xmax-16))	Pod_x=LCD_Xmax-16; // Pod Boundary check
	if (Pod_x<0)              Pod_x=0;

}
//////////////////////////////////////////////////////////////////////
int gameOver(int gameFlag, int lives, int score) //gameover trigger
{
	if ((lives == 0)|| score >= 1000)
	{
		gameFlag = 0;
		clear_LCD();
		draw_LCD(gameover);
	}
	
	return gameFlag; //returns flag to stop Thread 3 and 4
}
/////////////////////////////////////////////////////////////////////
void gameLoop(int KeypadVal) //keypad version
{
	generate_alien();
	generate_pod();
	
	switch(KeypadVal)  //controls x coordinate of the pod
		{
			case 4: Pod_x = Pod_x - Xspeed; 
							break;
			
			case 6: Pod_x = Pod_x + Xspeed; 
							break;
			
			default: break;
		}
	CollisionCheck();
}
//////////////////////////////////////////////////////////////////////
void gameLoop2(float ADCVal) // adc version 
{
	generate_alien();
	generate_pod();
	
	Pod_x = (ADCVal/255)*127; //controls x coordinate of the pod
	
	CollisionCheck();
}